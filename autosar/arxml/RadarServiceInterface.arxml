AUTOSAR XML (schema 4-2-2)
standard types defined: boolean, uint8, uint16, uint32, uint64, sint8, sint16, sint32, sint64, float32, float64
package /DataTypes/ImplementationDataTypes
  impl type DynamicDataArray: category=VECTOR
    element payloadDim1Element: category=TYPE_REFERENCE, base-type=uint8
  impl type RadarObjets: category=STRUCTURE
    element active: category=VALUE, base-type=boolean
    element objects: category=VALUE, implementation-data-type=DynamicDataArray
  impl type Position: category=STRUCTURE
    element x: category=VALUE, base-type=uint32
    element y: category=VALUE, base-type=uint32
    element z: category=VALUE, base-type=uint32
package /ServiceInterfaces
  service interface Radar
    namespaces:
      symbol props first: symbol=com
      symbol props second: symbol=myCompany
    events:
      data BrakeEvent: type=RadarObjets
    methods:
      operation Calibrate
        argument result: type=boolean, direction=OUT
        argument configuration: type=Position, direction=IN
      operation Adjust
        argument target_position: type=Position, direction=IN
        argument success: type=boolean, direction=OUT
        argument effective_position: type=Position, direction=OUT
package /ServiceInterfaceDeployments
  someip service interface RadarSomeip: service-interface-id=31, service-interface=Radar
    event-deployments:
      someip event BrakeEvent: event=BrakeEvent, event-id=1, transport-protocol=tcp
    method-deployment:
      someip method Calibrate: method=Calibrate, method-id=2, transport-protocol=tcp
      someip method Adjust: method=Adjust, method-id=3, transport-protocol=tcp
    someip service interface version RadarServiceInterfaceVersion: major-version=1, minor-version=1
    someip event group eventGroupAll: event-group-id=1, events=BrakeEvent
package /ServiceInstances
  provided someip service instance RadarSOmeipInstance: service-instance-id=1, service-interface=RadarSomeip, someip-provided-event-group{event-group=eventGroupAll, multicast-threshold=2}
  required someip service instance RadarSOmeipInstance: service-instance-id=ANY, service-interface=RadarSomeip
    someip-required-event-group event-group=eventGroupAll:
      sd client event timing config EventGroupAllTimingConfig: time-to-live=3
package /TransformationPropsSets
  transformation props set TransformationPropsSet
    ap someip transformation props Radar: alignment=1, byte-order=little-endian, session-handling=SESSION-HANDLING-INACTIVE, size-of-array-length-field=4, size-of-struct-length-field=4, size-of-union-length-field=4, size-of-union-type-selector-field=4
