AUTOSAR XML (schema 4-2-2)
standard types defined: sint32
package /DataTypes/ApplicationDataTypes
  7 x app type, all with category=VALUE:
    AdtLearn_Percent: base-type=sint32
    AdtLearn_Request: compu-method=Learn_Request
    AdtLearn_Result: compu {0=Learn_ActiveResult_Sucessful, 1=Learn_ActiveResult_failed, 2=Learn_ActiveResult_ITScheckfailed, 3=Learn_ActiveResult_ETScheckfailed}
    AdtDelete_Request: compu-method=Delete_Request
    AdtDelete_Status: compu-method=Delete_Status
    AdtLearn_Inative: compu-method=Learn_Inative
    AdtInactive_Result: compu {0=Inactive_ResultSucessful, 1=Inactive_ResultFailed}
package /DataTypes/CompuMethods
  compu method Learn_Active: 0=Learn_Active
  compu method DeleteFunction_FingerPrintDelete: 0=Delete_AllFingers, 1..8=Delete_Finger1..Delete_Finger8
  compu method Delete_Result: 0=Delete_Result_Sucessful, 1=Delete_Result_Failed
  compu method Learn_Inactive: 0=Learn_Inactive
package /ServiceInterfaces
  service interface Fingerpint_ManagementInterface
    events:
      data FingerPrintManagement_HMI_LearnPercent: type=AdtLearn_Percent
    methods:
      operation HMI_FingerPrint_Active
        arg Learn_Active: type=AdtLearn_Request, direction=IN
        arg Learn_Result: type=AdtLearn_Result, direction=OUT
      operation HMI_FingerPrint_Delete
        arg Delete_Request: type=AdtDelete_Request, direction=IN
        arg Delete_Result: type=AdtDelete_Status, direction=OUT
      operation HMI_FingerPrint_Inactive
        arg Inactive_Request: type=AdtLearn_Inative, direction=IN
        arg Inactive_Result: type=AdtInactive_Result, direction=OUT
    namespaces:
      symbol props first: symbol=com
      symbol props second: symbol=hinge
package /ServiceInterfaceDeployments
  someip service interface Fingerpint_ManagementInterface: service-interface-id=1, service-interface=Fingerpint_ManagementInterface
    event-deployments:
      someip event FingerPrintManagement_HMI_LearnPercent: event=FingerPrintManagement_HMI_LearnPercent, event-id=1, transport-protocol=TCP
    method-deployments:
      someip method HMI_FingerPrint_Inactive: method=HMI_FingerPrint_Inactive, method-id=1, transport-protocol=tcp
      someip method HMI_FingerPrint_Active: method=HMI_FingerPrint_Active, method-id=2, transport-protocol=tcp
      someip method HMI_FingerPrint_Delete: method=HMI_FingerPrint_Delete, method-id=3, transport-protocol=tcp
    someip service interface version Fingerpint_ManagementInterfaceVersion: major-version=1, minor-version=1
    someip event group eventGroupAll: event-group-id=1, events=FingerPrintManagement_HMI_LearnPercent
package /ServiceInstances
  required someip service instance Fingerpint_ManagementInterfaceInstance: service-instance-id=ANY, service-interface=Fingerpint_ManagementInterface
    someip-required-event-group event-group=eventGroupAll:
      sd client event timing config EventGroupAllTimingConfig: time-to-live=3
package /TransformationPropsSets
  transformation props set TransformationPropsSet
    ap someip transformation props Fingerpint_Management: alignment=1, byte-order=big-endian, session-handling=SESSION-HANDLING-INACTIVE, size-of-array-length-field=4, size-of-struct-length-field=4, size-of-union-length-field=4, size-of-union-type-selector-field=4
