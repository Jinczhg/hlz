AUTOSAR XML (schema 4-2-2)
standard types defined: boolean, uint8, uint16, uint32, uint64, sint8, sint16, sint32, sint64, float32, float64
package /DataTypes
  ar packages ImplementationDataTypes
    impl type string: category=STRING
